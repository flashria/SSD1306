 
/*
 * SSD1306.S
 *
 * Created: 2015/5/15 18:21:23
 *  Author: Administrator
 */ 
#include <avr/pgmspace.h>
#include <util/delay.h>
#include <stdlib.h>

#include "SSD1306.h"
 
 

 //-------------  ASCII字符库----------------------------------------------------------------
 //说明：该字库为5*7点阵字符字模库，但字库格式为8*8点阵字模数据，第8行为行间距，
 //      第6-8列为字间距。可以使用6*8点阵、7*8点阵、8*8点阵形式的字符显示
 const unsigned short ASCII6_8[][8] PROGMEM ={
	 0x00,0x00,0x00,0x00,0x00,0x00,0x00,0x00,    /*" "=00H 0x20*/
	 0x00,0x00,0x00,0x4F,0x00,0x00,0x00,0x00,    /*"!"=01H*/
	 0x00,0x00,0x07,0x00,0x07,0x00,0x00,0x00,    /*"""=02h*/
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		 0x00,0xFF,0xFF,0xFF,0xFF,0xFF,0x00,0x00     /*" "=0x60*/
	 };



void SSD1306::SSD1306_command(uint8_t c) {
	digitalWrite(cs, HIGH);
	digitalWrite(dc, LOW);
	digitalWrite(cs, LOW);
	spiwrite(c);
	digitalWrite(cs, HIGH);
}

void SSD1306::SSD1306_data(uint8_t c) {
	digitalWrite(cs, HIGH);
	digitalWrite(dc, HIGH);
	digitalWrite(cs, LOW);
	spiwrite(c);
	digitalWrite(cs, HIGH);
}
inline void SSD1306::spiwrite(uint8_t c) {
	shiftOut(sid, sclk, MSBFIRST, c);

}
void SSD1306::SSD1306_init() {
	// set pin directions
	pinMode(sid, OUTPUT);
	pinMode(sclk, OUTPUT);
	pinMode(dc, OUTPUT);
	pinMode(rst, OUTPUT);
	pinMode(cs, OUTPUT);

	digitalWrite(rst, HIGH);
	// VDD (3.3V) goes high at start, lets just chill for a ms
	delay(1);
	// bring0xset low
	digitalWrite(rst, LOW);
	// wait 10ms
	delay(10);
	// bring out of reset
	digitalWrite(rst, HIGH);

 
	
	  SSD1306_command (0xAE);  // 1.Set Display Off
                  
      SSD1306_command (0xD5); // 2.Set display Clock Divide Ratio/Oscillator Frequency
                  SSD1306_command (0x80);
                  
                  SSD1306_command (0xA8); // 3.Set Multiplex Ratio
                  SSD1306_command (0x3F);
                  
                  SSD1306_command (0xD3); // 4.Set Display Offset
                  SSD1306_command (0x00);
                  
                  SSD1306_command (0x40); // 5.Set Display Start Line

                  SSD1306_command (0x20);
                  SSD1306_command (0x10); //0x00
                  
                  SSD1306_command (0xA1); // 6.Set Segment Re-Map
                  
                  SSD1306_command (0xC8); // 7.Set COM Output Scan Direction
                  
                  SSD1306_command (0xDA); // 8.Set COM Pins Hardware Configurartion
                  SSD1306_command (0x12);
                  
                  SSD1306_command (0x81); // 9.Set Contrast Control   0x66
                  SSD1306_command (0x66); // 0xCF
                  
                  SSD1306_command (0xD9); // 10.Set Pre-Charge Period
                  SSD1306_command (0xF1);
                  
                  SSD1306_command (0xDB); // 11.Set VCOMH Deselect Level  0x30
                  SSD1306_command (0x30); // 0x40
                  
                  SSD1306_command (0xA4); // 12.Set Entire Display On/Off
                  
                  SSD1306_command (0xA6); // 13.Set Normal/Inverse Display
                  
                  SSD1306_command (0x8D);// 14.Set Charge Pump
                  SSD1306_command (0x14);
                  
                  SSD1306_command (0xAF); // 15.Set Display On
}


// clear everything
void SSD1306::clear(void) {
	//SSD1306_command (0xAE);
	 unsigned char j,i;
	 for(j=0;j<8;j++)
	 {
		 SSD1306_command(j|0xB0); //页地址设置
		 SSD1306_command(0x00);	   //列地址0
		 SSD1306_command(0x10);
		 
		 for(i=0;i<132;i++)
		 {
			 SSD1306_data(0);
		 }
	 }
	// SSD1306_command (0xAF);
}

void SSD1306::clear_display(void) {
	clear();
	display();
}
void SSD1306::invert(uint8_t i) {
	if (i) {
		SSD1306_command(Set_Invert);
		} else {
		SSD1306_command(Clr_Invert);
	}
}
void SSD1306::hide(void) {
	SSD1306_command(0xAE);//显示开启
}
void SSD1306::display(void) {
	SSD1306_command(0xAF);//显示开启
}


void SSD1306::drawstring(uint8_t x, uint8_t line, char *c) {
	WR_ADD(x,line);
	while (c[0] != 0) {
		drawchar( c[0]);
		c++;
	}

}

void  SSD1306::drawchar(uint8_t c) {
	
	unsigned char i,dat;
	for(i=0;i<6;i++)
	{
		dat=pgm_read_byte(&ASCII6_8[c-0x20][i]);
		SSD1306_data(dat);
	}
}



 //----------写字符地址----页--位
 void SSD1306::WR_ADD(uint8_t ye,uint8_t wei)
 {
	 SSD1306_command(ye|0xb0);//第x页(0-7)
	 wei*=6;
	 SSD1306_command(wei&0x0f); //字符位置地址L
	 wei=wei>>4;
	 SSD1306_command(wei|0x10); //字符位置地址H
 }
 

